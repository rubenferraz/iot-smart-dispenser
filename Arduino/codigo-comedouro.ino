#include <Arduino.h>
#include <WiFi.h>
#include "HX711.h"
#include <HTTPClient.h>
#include <Wire.h>
#include <Adafruit_GFX.h>
#include <Adafruit_SSD1306.h>

// Motor
#define IN1 18
#define IN2 19
#define IN3 21
#define IN4 22

const int stepSequence[8][4] = {
  {1, 0, 0, 0},
  {1, 1, 0, 0},
  {0, 1, 0, 0},
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  {1, 0, 0, 1}
};

// Balança
#define LOADCELL_DOUT_PIN 16
#define LOADCELL_SCK_PIN  4

HX711 scale;

// Wi-Fi
//const char* ssid = "MEOWIFI-50P1ZZ45";
//const char* password = "serrano34100";

//const char* ssid = "airCube-AP34";
//const char* password = "QD6TFDXRBN9";

//const char* ssid = "MEO-8262C0";
//const char* password = "d8379bf5e2";

const char* ssid = "Godji";
const char* password = "Ruben2002";

// URLs do servidor
const char* URL_PESO  = "https://83.212.82.121:7453/peso";
const char* URL_MOTOR = "https://83.212.82.121:7453/motor";

// OLED display config
#define SCREEN_WIDTH 128
#define SCREEN_HEIGHT 64
#define OLED_RESET    -1

Adafruit_SSD1306 display(SCREEN_WIDTH, SCREEN_HEIGHT, &Wire, OLED_RESET);

// Bitmaps
const unsigned char cat [] = {
0x00, 0x00, 0x00, 0x00, 0x00, 0x00, 0x00, 0x01, 0xF0, 0x00, 0x00, 0x00, 0x0C, 0x00, 0x00, 0x00,
0x00, 0x00, 0x00, 0x00, 0x00, 0x00, 0x00, 0x03, 0xFF, 0xFF, 0xFF, 0xF8, 0xFF, 0x00, 0x00, 0x00,
0x00, 0x00, 0x00, 0x00, 0x00, 0x00, 0x00, 0x03, 0xFF, 0xFF, 0xFF, 0xFF, 0xFF, 0x80, 0x00, 0x00,
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0x00, 0x00, 0x00, 0x00, 0x00, 0x00, 0x00, 0x00, 0x00, 0x00, 0x00, 0x7F, 0xFE, 0x00, 0x00, 0x00
};


const unsigned char cat2 [] = {
0x00, 0x00, 0x00, 0x00, 0x00, 0x00, 0x00, 0x00, 0x00, 0x00, 0x00, 0x00, 0x00, 0x00, 0x00, 0x00,
0x00, 0x00, 0x00, 0x00, 0x00, 0x00, 0x00, 0x00, 0x00, 0x00, 0x00, 0x00, 0x00, 0x00, 0x00, 0x00,
0x00, 0x00, 0x00, 0x00, 0x00, 0x00, 0x00, 0x00, 0x00, 0x00, 0x00, 0x00, 0x00, 0x00, 0x00, 0x00,
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0x00, 0x00, 0x00, 0x00, 0x00, 0x00, 0x00, 0x00, 0x00, 0x00, 0x00, 0x00, 0x00, 0x00, 0x00, 0x00
};


void rodarMotor() {
  Serial.println("A rodar motor!");
  for (int i = 0; i < 128; i++) {
    for (int j = 0; j < 8; j++) {
      digitalWrite(IN1, stepSequence[j][0]);
      digitalWrite(IN2, stepSequence[j][1]);
      digitalWrite(IN3, stepSequence[j][2]);
      digitalWrite(IN4, stepSequence[j][3]);
      delay(1);
    }
  }
}

unsigned long lastImageSwitch = 0;
bool mostrarPrimeiraImagem = true;

void setup() {
  Serial.begin(115200);

  // Motor
  pinMode(IN1, OUTPUT);
  pinMode(IN2, OUTPUT);
  pinMode(IN3, OUTPUT);
  pinMode(IN4, OUTPUT);

  // Balança
  scale.begin(LOADCELL_DOUT_PIN, LOADCELL_SCK_PIN);
  scale.set_scale(-690);
  scale.tare();

  // OLED init
  Wire.begin(26, 27);  // SDA, SCL
  if(!display.begin(SSD1306_SWITCHCAPVCC, 0x3C)) {
    Serial.println(F("Falha ao iniciar o OLED"));
    while(true);
  }
  display.clearDisplay();
  display.drawBitmap(0, 0, cat, 128, 64, SSD1306_WHITE);
  display.display();

  // Wi-Fi
  WiFi.begin(ssid, password);
  Serial.print("A ligar ao Wi-Fi");
  while (WiFi.status() != WL_CONNECTED) {
    delay(500);
    Serial.print(".");
  }
  Serial.println("\nWiFi ligado. IP:");
  Serial.println(WiFi.localIP());
}

void loop() {
  static unsigned long lastSend = 0;

  unsigned long now = millis();

  // Alterna imagem a cada 10 segundos (10000 ms)
  if (now - lastImageSwitch > 10000) {
    lastImageSwitch = now;
    mostrarPrimeiraImagem = !mostrarPrimeiraImagem;

    display.clearDisplay();
    if(mostrarPrimeiraImagem) {
      display.drawBitmap(0, 0, cat, 128, 64, SSD1306_WHITE);
    } else {
      display.drawBitmap(0, 0, cat2, 128, 64, SSD1306_WHITE);
    }
    display.display();
  }

  if (now - lastSend > 500) {
    if (WiFi.status() == WL_CONNECTED) {
      float peso = scale.get_units(5);

      // Envia o peso
      HTTPClient http;
      http.begin(URL_PESO);
      http.addHeader("Content-Type", "application/json");

      String json = "{\"peso\": " + String(peso, 2) + "}";
      int httpResponseCode = http.POST(json);
      Serial.printf("POST peso: %d\n", httpResponseCode);
      http.end();
  

      // Verifica se deve rodar o motor
      HTTPClient motorRequest;
      motorRequest.begin(URL_MOTOR);
      int motorCode = motorRequest.GET();
      if (motorCode == 200) {
        String resposta = motorRequest.getString();
        if (resposta.indexOf("true") != -1) {
          rodarMotor();
        }
      } else {
        Serial.printf("Erro GET motor: %d\n", motorCode);
      }
      motorRequest.end();
    }
    lastSend = now;
  }
}
